## configs/antminer_s19j_defconfig
```kconfig
# Buildroot Defconfig for Antminer S19J Control Board v2.5 (AM335x)
BR2_arm=y
BR2_cortex_a8=y
BR2_ARM_EABIHF=y
BR2_PACKAGE_HOST_LINUX_HEADERS_CUSTOM_6_6=y

# System Configuration
BR2_TARGET_GENERIC_HOSTNAME="antminer-s19j"
BR2_TARGET_GENERIC_ISSUE="Welcome to Buildroot on Antminer S19J v2.5"
BR2_TARGET_GENERIC_GETTY_PORT="ttyS0"
BR2_TARGET_GENERIC_GETTY_BAUDRATE_115200=y

# Kernel Configuration
BR2_LINUX_KERNEL=y
BR2_LINUX_KERNEL_CUSTOM_VERSION=y
BR2_LINUX_KERNEL_CUSTOM_VERSION_VALUE="6.6.58"
BR2_LINUX_KERNEL_DEFCONFIG="omap2plus"
BR2_LINUX_KERNEL_DTS_SUPPORT=y
BR2_LINUX_KERNEL_INTREE_DTS_NAME="ti/omap/am335x-antminer"

# Filesystem & Utilities
BR2_TARGET_ROOTFS_EXT2=y
BR2_TARGET_ROOTFS_EXT2_4=y
BR2_PACKAGE_BUSYBOX=y
BR2_PACKAGE_MTD=y
BR2_PACKAGE_ETHTOOL=y
BR2_PACKAGE_IPROUTE2=y
BR2_PACKAGE_I2C_TOOLS=y

# SSH Server (zlib required by dropbear)
BR2_PACKAGE_ZLIB=y
BR2_PACKAGE_DROPBEAR=y
BR2_PACKAGE_DROPBEAR_CLIENT=y
```
